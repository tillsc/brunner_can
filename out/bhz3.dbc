VERSION ""

NS_ :

BS_:

BU_: BHZ3

BO_ 2618310656 BHZ3_VOLUMENSTROM_SOLAR: 4 BHZ3
  SG_ BHZ3_VOLUMENSTROM_SOLAR : 15|16@0- (0.1,0) [0|0] "l/min" DBG

BO_ 2618310657 BHZ3_VOLUMENSTROM_WW: 4 BHZ3
  SG_ BHZ3_VOLUMENSTROM_WW : 15|16@0- (0.1,0) [0|0] "l/min" DBG

BO_ 2618310659 BHZ3_VOLUMENSTROM_FESTBRENNOFEN: 4 BHZ3
  SG_ BHZ3_VOLUMENSTROM_FESTBRENNOFEN : 15|16@0- (0.1,0) [0|0] "l/min" DBG

BO_ 2618310660 BHZ3_VOLUMENSTROM_ZUSATZHEIZUNG: 4 BHZ3
  SG_ BHZ3_VOLUMENSTROM_ZUSATZHEIZUNG : 15|16@0- (0.1,0) [0|0] "l/min" DBG

BO_ 2618310661 BHZ3_DRUCK_PUFFER: 4 BHZ3
  SG_ BHZ3_DRUCK_PUFFER : 15|16@0- (0.1,0) [0|0] "bar" DBG

BO_ 2618310662 BHZ3_VOLUMENSTROM_HK1: 4 BHZ3
  SG_ BHZ3_VOLUMENSTROM_HK1 : 15|16@0- (0.1,0) [0|0] "l/min" DBG

BO_ 2618310665 BHZ3_TEMPERATUR_HK1_VL: 4 BHZ3
  SG_ BHZ3_TEMPERATUR_HK1_VL : 15|16@0- (0.1,0) [0|0] "°C" DBG

BO_ 2618310666 BHZ3_TEMPERATUR_HK2_VL: 4 BHZ3
  SG_ BHZ3_TEMPERATUR_HK2_VL : 15|16@0- (0.1,0) [0|0] "°C" DBG

BO_ 2618310667 BHZ3_TEMPERATUR_PUFFER_OBEN: 4 BHZ3
  SG_ BHZ3_TEMPERATUR_PUFFER_OBEN : 15|16@0- (0.1,0) [0|0] "°C" DBG

BO_ 2618310668 BHZ3_TEMPERATUR_PUFFER_MITTE: 4 BHZ3
  SG_ BHZ3_TEMPERATUR_PUFFER_MITTE : 15|16@0- (0.1,0) [0|0] "°C" DBG

BO_ 2618310669 BHZ3_TEMPERATUR_PUFFER_UNTEN: 4 BHZ3
  SG_ BHZ3_TEMPERATUR_PUFFER_UNTEN : 15|16@0- (0.1,0) [0|0] "°C" DBG

BO_ 2618310670 BHZ3_TEMPERATUR_SOLAR_EINTRAG_PUFFER: 4 BHZ3
  SG_ BHZ3_TEMPERATUR_SOLAR_EINTRAG_PUFFER : 15|16@0- (0.1,0) [0|0] "°C" DBG

BO_ 2618310671 BHZ3_TEMPERATUR_SOLAR_KOLLEKTORTEMPERATUR: 4 BHZ3
  SG_ BHZ3_TEMPERATUR_SOLAR_KOLLEKTORTEMPERATUR : 15|16@0- (0.1,0) [0|0] "°C" DBG

BO_ 2618310672 BHZ3_TEMPERATUR_SOLAR_RL: 4 BHZ3
  SG_ BHZ3_TEMPERATUR_SOLAR_RL : 15|16@0- (0.1,0) [0|0] "°C" DBG

BO_ 2618310674 BHZ3_TEMPERATUR_WW_ZIRKULATION: 4 BHZ3
  SG_ BHZ3_TEMPERATUR_WW_ZIRKULATION : 15|16@0- (0.1,0) [0|0] "°C" DBG

BO_ 2618310675 BHZ3_TEMPERATUR_WETTER: 4 BHZ3
  SG_ BHZ3_TEMPERATUR_WETTER : 15|16@0- (0.1,0) [0|0] "°C" DBG

BO_ 2618310676 BHZ3_TEMPERATUR_FESTBRENNOFEN_KESSELTEMPERATUR: 4 BHZ3
  SG_ BHZ3_TEMPERATUR_FESTBRENNOFEN_KESSELTEMPERATUR : 15|16@0- (0.1,0) [0|0] "°C" DBG

BO_ 2618310677 BHZ3_TEMPERATUR_FESTBRENNOFEN_KESSEL_RL: 4 BHZ3
  SG_ BHZ3_TEMPERATUR_FESTBRENNOFEN_KESSEL_RL : 15|16@0- (0.1,0) [0|0] "°C" DBG

BO_ 2618310678 BHZ3_TEMPERATUR_SOLAR_SEK_RL: 4 BHZ3
  SG_ BHZ3_TEMPERATUR_SOLAR_SEK_RL : 15|16@0- (0.1,0) [0|0] "°C" DBG

BO_ 2618310681 BHZ3_TEMPERATUR_SOLAR_PRIM_VL: 4 BHZ3
  SG_ BHZ3_TEMPERATUR_SOLAR_PRIM_VL : 15|16@0- (0.1,0) [0|0] "°C" DBG

BO_ 2618310683 BHZ3_TEMPERATUR_ZUSATZHEIZUNG_VL: 4 BHZ3
  SG_ BHZ3_TEMPERATUR_ZUSATZHEIZUNG_VL : 15|16@0- (0.1,0) [0|0] "°C" DBG

BO_ 2618310684 BHZ3_TEMPERATUR_ZUSATZHEIZUNG_RL: 4 BHZ3
  SG_ BHZ3_TEMPERATUR_ZUSATZHEIZUNG_RL : 15|16@0- (0.1,0) [0|0] "°C" DBG

BO_ 2618310686 BHZ3_TEMPERATUR_HK1_RL: 4 BHZ3
  SG_ BHZ3_TEMPERATUR_HK1_RL : 15|16@0- (0.1,0) [0|0] "°C" DBG

BO_ 2618310687 BHZ3_TEMPERATUR_HK2_RL: 4 BHZ3
  SG_ BHZ3_TEMPERATUR_HK2_RL : 15|16@0- (0.1,0) [0|0] "°C" DBG

BO_ 2618310688 BHZ3_TEMPERATUR_WW_PRIM_VL: 4 BHZ3
  SG_ BHZ3_TEMPERATUR_WW_PRIM_VL : 15|16@0- (0.1,0) [0|0] "°C" DBG

BO_ 2618310689 BHZ3_TEMPERATUR_WW_PRIM_RL: 4 BHZ3
  SG_ BHZ3_TEMPERATUR_WW_PRIM_RL : 15|16@0- (0.1,0) [0|0] "°C" DBG

BO_ 2618310690 BHZ3_TEMPERATUR_WW_IST: 4 BHZ3
  SG_ BHZ3_TEMPERATUR_WW_IST : 15|16@0- (0.1,0) [0|0] "°C" DBG

BO_ 2618318850 BHZ3_UNKLAHR_WW: 4 BHZ3
  SG_ BHZ3_UNKLAHR_WW : 15|16@0- (1,0) [0|0] "" DBG

BO_ 2618318856 BHZ3_STATUS_HK1_EIN_AUS: 4 BHZ3
  SG_ BHZ3_STATUS_HK1_EIN_AUS : 15|16@0- (1,0) [0|0] "" DBG

BO_ 2618318858 BHZ3_STATUS_HK1_AUS_EIN: 4 BHZ3
  SG_ BHZ3_STATUS_HK1_AUS_EIN : 15|16@0- (1,0) [0|0] "" DBG

BO_ 2618318867 BHZ3_STATUS_ZUSATZHEIZUNG_AKTIV: 4 BHZ3
  SG_ BHZ3_STATUS_ZUSATZHEIZUNG_AKTIV : 15|16@0- (1,0) [0|0] "" DBG

BO_ 2618327066 BHZ3_LEISTUNG_FESTBRENNOFEN: 4 BHZ3
  SG_ BHZ3_LEISTUNG_FESTBRENNOFEN : 15|16@0- (0.1,0) [0|0] "kw" DBG

BO_ 2618327069 BHZ3_GESAMTLEISTUNG_FESTBRENNOFEN_HEUTE: 4 BHZ3
  SG_ BHZ3_GESAMTLEISTUNG_FESTBRENNOFEN_HEUTE : 15|16@0- (0.1,0) [0|0] "kwh" DBG

BO_ 2618327070 BHZ3_GESAMTLEISTUNG_FESTBRENNOFEN_GESTERN: 4 BHZ3
  SG_ BHZ3_GESAMTLEISTUNG_FESTBRENNOFEN_GESTERN : 15|16@0- (0.1,0) [0|0] "kwh" DBG

BO_ 2618327071 BHZ3_GESAMTLEISTUNG_FESTBRENNOFEN_5_TAGE_OHNE_HEUTE: 4 BHZ3
  SG_ BHZ3_GESAMTLEISTUNG_FESTBRENNOFEN_5_TAGE_OHNE_HEUTE : 15|16@0- (0.1,0) [0|0] "kwh" DBG

BO_ 2618327072 BHZ3_GESAMTLEISTUNG_FESTBRENNOFEN_30_TAGE_OHNE_HEUTE: 4 BHZ3
  SG_ BHZ3_GESAMTLEISTUNG_FESTBRENNOFEN_30_TAGE_OHNE_HEUTE : 15|16@0- (1,0) [0|0] "kwh" DBG

BO_ 2618336273 BHZ3_STATUS_ZUSATZHEIZUNG_AKTIVIERT_FUER: 4 BHZ3
  SG_ BHZ3_STATUS_ZUSATZHEIZUNG_AKTIVIERT_FUER : 15|16@0- (1,0) [0|0] "" DBG

BO_ 2618336275 BHZ3_STATUS_ZUSATZHEIZUNG_EIN_AUS: 4 BHZ3
  SG_ BHZ3_STATUS_ZUSATZHEIZUNG_EIN_AUS : 15|16@0- (1,0) [0|0] "" DBG

BO_ 2618343449 BHZ3_STATUS_WW_ZIRKULATIONSPROGRAMM: 4 BHZ3
  SG_ BHZ3_STATUS_WW_ZIRKULATIONSPROGRAMM : 15|16@0- (1,0) [0|0] "" DBG

BO_ 2618343479 BHZ3_TEMPERATUR_WW_SOLL: 4 BHZ3
  SG_ BHZ3_TEMPERATUR_WW_SOLL : 15|16@0- (0.1,0) [0|0] "°C" DBG

BO_ 2618368006 BHZ3_VOLUMENSTROM_WW_SPEICHER: 4 BHZ3
  SG_ BHZ3_VOLUMENSTROM_WW_SPEICHER : 15|16@0- (0.1,0) [0|0] "l/min" DBG

BO_ 2618368014 BHZ3_STATUS_HK1_ABSENKART: 4 BHZ3
  SG_ BHZ3_STATUS_HK1_ABSENKART : 15|16@0- (1,0) [0|0] "" DBG

BO_ 2618368019 BHZ3_STATUS_HK1_SOMMERBETRIEB: 4 BHZ3
  SG_ BHZ3_STATUS_HK1_SOMMERBETRIEB : 15|16@0- (0.1,0) [0|0] "°C" DBG

BO_ 2618368030 BHZ3_STATUS_HK1_DAUERBETRIEB: 4 BHZ3
  SG_ BHZ3_STATUS_HK1_DAUERBETRIEB : 15|16@0- (1,0) [0|0] "h" DBG

BO_ 2618368031 BHZ3_STATUS_HK1_ABWESENHEITSZEIT: 4 BHZ3
  SG_ BHZ3_STATUS_HK1_ABWESENHEITSZEIT : 15|16@0- (1,0) [0|0] "d" DBG

BO_ 2618368034 BHZ3_STATUS_HK1_PROGRAMM: 4 BHZ3
  SG_ BHZ3_STATUS_HK1_PROGRAMM : 15|16@0- (1,0) [0|0] "" DBG

BO_ 2618368036 BHZ3_STATUS_HK1_WAERMER_KAELTER: 4 BHZ3
  SG_ BHZ3_STATUS_HK1_WAERMER_KAELTER : 15|16@0- (0.1,0) [0|0] "°C" DBG

BO_ 2618376198 BHZ3_LEISTUNG_ZUSATZHEIZUNG: 4 BHZ3
  SG_ BHZ3_LEISTUNG_ZUSATZHEIZUNG : 15|16@0- (0.1,0) [0|0] "kw" DBG

BO_ 2618376201 BHZ3_GESAMTLEISTUNG_ZUSATZHEIZUNG_HEUTE: 4 BHZ3
  SG_ BHZ3_GESAMTLEISTUNG_ZUSATZHEIZUNG_HEUTE : 15|16@0- (0.1,0) [0|0] "kwh" DBG

BO_ 2618376202 BHZ3_GESAMTLEISTUNG_ZUSATZHEIZUNG_GESTERN: 4 BHZ3
  SG_ BHZ3_GESAMTLEISTUNG_ZUSATZHEIZUNG_GESTERN : 15|16@0- (0.1,0) [0|0] "kwh" DBG

BO_ 2618376203 BHZ3_GESAMTLEISTUNG_ZUSATZHEIZUNG_5_TAGE_OHNE_HEUTE: 4 BHZ3
  SG_ BHZ3_GESAMTLEISTUNG_ZUSATZHEIZUNG_5_TAGE_OHNE_HEUTE : 15|16@0- (0.1,0) [0|0] "kwh" DBG

BO_ 2618376204 BHZ3_GESAMTLEISTUNG_ZUSATZHEIZUNG_LETZTE_4_WOCHEN_OHNE_HEUTE: 4 BHZ3
  SG_ BHZ3_GESAMTLEISTUNG_ZUSATZHEIZUNG_LETZTE_4_WOCHEN_OHNE_HEUTE : 15|16@0- (1,0) [0|0] "kwh" DBG

BO_ 2618377222 BHZ3_LEISTUNG_HK1: 4 BHZ3
  SG_ BHZ3_LEISTUNG_HK1 : 15|16@0- (0.1,0) [0|0] "kw" DBG

BO_ 2618377225 BHZ3_GESAMTLEISTUNG_HK1_HEUTE: 4 BHZ3
  SG_ BHZ3_GESAMTLEISTUNG_HK1_HEUTE : 15|16@0- (0.1,0) [0|0] "kwh" DBG

BO_ 2618377226 BHZ3_GESAMTLEISTUNG_HK1_GESTERN: 4 BHZ3
  SG_ BHZ3_GESAMTLEISTUNG_HK1_GESTERN : 15|16@0- (0.1,0) [0|0] "kwh" DBG

BO_ 2618377227 BHZ3_GESAMTLEISTUNG_HK1_5_TAGE_OHNE_HEUTE: 4 BHZ3
  SG_ BHZ3_GESAMTLEISTUNG_HK1_5_TAGE_OHNE_HEUTE : 15|16@0- (0.1,0) [0|0] "kwh" DBG

BO_ 2618377228 BHZ3_GESAMTLEISTUNG_HK1_LETZTE_4_WOCHEN_OHNE_HEUTE: 4 BHZ3
  SG_ BHZ3_GESAMTLEISTUNG_HK1_LETZTE_4_WOCHEN_OHNE_HEUTE : 15|16@0- (1,0) [0|0] "kwh" DBG

BO_ 2618379270 BHZ3_LEISTUNG_WW: 4 BHZ3
  SG_ BHZ3_LEISTUNG_WW : 15|16@0- (0.1,0) [0|0] "kw" DBG

BO_ 2618379273 BHZ3_GESAMTLEISTUNG_WW_HEUTE: 4 BHZ3
  SG_ BHZ3_GESAMTLEISTUNG_WW_HEUTE : 15|16@0- (0.1,0) [0|0] "kwh" DBG

BO_ 2618379274 BHZ3_GESAMTLEISTUNG_WW_GESTERN: 4 BHZ3
  SG_ BHZ3_GESAMTLEISTUNG_WW_GESTERN : 15|16@0- (0.1,0) [0|0] "kwh" DBG

BO_ 2618379275 BHZ3_GESAMTLEISTUNG_WW_5_TAGE_OHNE_HEUTE: 4 BHZ3
  SG_ BHZ3_GESAMTLEISTUNG_WW_5_TAGE_OHNE_HEUTE : 15|16@0- (0.1,0) [0|0] "kwh" DBG

BO_ 2618379276 BHZ3_GESAMTLEISTUNG_WW_LETZTE_4_WOCHEN_OHNE_HEUTE: 4 BHZ3
  SG_ BHZ3_GESAMTLEISTUNG_WW_LETZTE_4_WOCHEN_OHNE_HEUTE : 15|16@0- (1,0) [0|0] "kwh" DBG

BO_ 2618380294 BHZ3_LEISTUNG_SOLAR: 4 BHZ3
  SG_ BHZ3_LEISTUNG_SOLAR : 15|16@0- (0.1,0) [0|0] "kw" DBG

BO_ 2618380297 BHZ3_GESAMTLEISTUNG_SOLAR_HEUTE: 4 BHZ3
  SG_ BHZ3_GESAMTLEISTUNG_SOLAR_HEUTE : 15|16@0- (0.1,0) [0|0] "kwh" DBG

BO_ 2618380298 BHZ3_GESAMTLEISTUNG_SOLAR_GESTERN: 4 BHZ3
  SG_ BHZ3_GESAMTLEISTUNG_SOLAR_GESTERN : 15|16@0- (0.1,0) [0|0] "kwh" DBG

BO_ 2618380299 BHZ3_GESAMTLEISTUNG_SOLAR_5_TAGE_OHNE_HEUTE: 4 BHZ3
  SG_ BHZ3_GESAMTLEISTUNG_SOLAR_5_TAGE_OHNE_HEUTE : 15|16@0- (0.1,0) [0|0] "kwh" DBG

BO_ 2618380300 BHZ3_GESAMTLEISTUNG_SOLAR_LETZTE_4_WOCHEN_OHNE_HEUTE: 4 BHZ3
  SG_ BHZ3_GESAMTLEISTUNG_SOLAR_LETZTE_4_WOCHEN_OHNE_HEUTE : 15|16@0- (1,0) [0|0] "kwh" DBG

CM_ BO_ 2618310656 "Volumenstrom Solar ";

CM_ BO_ 2618310657 "Volumenstrom WW ";

CM_ BO_ 2618310659 "Volumenstrom Festbrennofen ";

CM_ BO_ 2618310660 "Volumenstrom Zusatzheizung ";

CM_ BO_ 2618310661 "Druck Puffer ";

CM_ BO_ 2618310662 "Volumenstrom HK1 ";

CM_ BO_ 2618310665 "Temperatur HK1 VL";

CM_ BO_ 2618310666 "Temperatur HK2 VL";

CM_ BO_ 2618310667 "Temperatur Puffer Oben";

CM_ BO_ 2618310668 "Temperatur Puffer Mitte";

CM_ BO_ 2618310669 "Temperatur Puffer Unten";

CM_ BO_ 2618310670 "Temperatur Solar Eintrag Puffer";

CM_ BO_ 2618310671 "Temperatur Solar Kollektortemperatur";

CM_ BO_ 2618310672 "Temperatur Solar RL";

CM_ BO_ 2618310674 "Temperatur WW Zirkulation";

CM_ BO_ 2618310675 "Temperatur Wetter ";

CM_ BO_ 2618310676 "Temperatur Festbrennofen Kesseltemperatur";

CM_ BO_ 2618310677 "Temperatur Festbrennofen Kessel RL";

CM_ BO_ 2618310678 "Temperatur Solar Sek RL";

CM_ BO_ 2618310681 "Temperatur Solar Prim VL";

CM_ BO_ 2618310683 "Temperatur Zusatzheizung VL";

CM_ BO_ 2618310684 "Temperatur Zusatzheizung RL";

CM_ BO_ 2618310686 "Temperatur HK1 RL";

CM_ BO_ 2618310687 "Temperatur HK2 RL";

CM_ BO_ 2618310688 "Temperatur WW Prim VL";

CM_ BO_ 2618310689 "Temperatur WW Prim RL";

CM_ BO_ 2618310690 "Temperatur WW Ist";

CM_ BO_ 2618318850 "UNKLAHR WW ";

CM_ BO_ 2618318856 "Status HK1 Ein Aus";
CM_ SG_ 2618318856 BHZ3_STATUS_HK1_EIN_AUS "Ein=1, Aus=0";

CM_ BO_ 2618318858 "Status HK1 Aus Ein";
CM_ SG_ 2618318858 BHZ3_STATUS_HK1_AUS_EIN "Aus=1, Ein=0";

CM_ BO_ 2618318867 "Status Zusatzheizung aktiv";
CM_ SG_ 2618318867 BHZ3_STATUS_ZUSATZHEIZUNG_AKTIV "0, 1";

CM_ BO_ 2618327066 "Leistung Festbrennofen ";

CM_ BO_ 2618327069 "Gesamtleistung Festbrennofen Heute";

CM_ BO_ 2618327070 "Gesamtleistung Festbrennofen Gestern";

CM_ BO_ 2618327071 "Gesamtleistung Festbrennofen 5 Tage ohne Heute";

CM_ BO_ 2618327072 "Gesamtleistung Festbrennofen 30 Tage ohne Heute";

CM_ BO_ 2618336273 "Status Zusatzheizung Aktiviert fuer";
CM_ SG_ 2618336273 BHZ3_STATUS_ZUSATZHEIZUNG_AKTIVIERT_FUER "0 - 5";

CM_ BO_ 2618336275 "Status Zusatzheizung Ein Aus";
CM_ SG_ 2618336275 BHZ3_STATUS_ZUSATZHEIZUNG_EIN_AUS "0, 1";

CM_ BO_ 2618343449 "Status WW Zirkulationsprogramm";
CM_ SG_ 2618343449 BHZ3_STATUS_WW_ZIRKULATIONSPROGRAMM "0 - 5";

CM_ BO_ 2618343479 "Temperatur WW Soll";

CM_ BO_ 2618368006 "Volumenstrom WW-Speicher ";

CM_ BO_ 2618368014 "Status HK1 Absenkart";
CM_ SG_ 2618368014 BHZ3_STATUS_HK1_ABSENKART "0 - 4";

CM_ BO_ 2618368019 "Status HK1 Sommerbetrieb";

CM_ BO_ 2618368030 "Status HK1 Dauerbetrieb";
CM_ SG_ 2618368030 BHZ3_STATUS_HK1_DAUERBETRIEB "Zählt runter";

CM_ BO_ 2618368031 "Status HK1 Abwesenheitszeit";
CM_ SG_ 2618368031 BHZ3_STATUS_HK1_ABWESENHEITSZEIT "Zählt runter";

CM_ BO_ 2618368034 "Status HK1 Programm";
CM_ SG_ 2618368034 BHZ3_STATUS_HK1_PROGRAMM "0 - 5";

CM_ BO_ 2618368036 "Status HK1 Waermer Kaelter";

CM_ BO_ 2618376198 "Leistung Zusatzheizung ";

CM_ BO_ 2618376201 "Gesamtleistung Zusatzheizung Heute";

CM_ BO_ 2618376202 "Gesamtleistung Zusatzheizung Gestern";

CM_ BO_ 2618376203 "Gesamtleistung Zusatzheizung 5 Tage ohne Heute";

CM_ BO_ 2618376204 "Gesamtleistung Zusatzheizung Letzte 4 Wochen ohne Heute";

CM_ BO_ 2618377222 "Leistung HK1 ";

CM_ BO_ 2618377225 "Gesamtleistung HK1 Heute";

CM_ BO_ 2618377226 "Gesamtleistung HK1 Gestern";

CM_ BO_ 2618377227 "Gesamtleistung HK1 5 Tage ohne Heute";

CM_ BO_ 2618377228 "Gesamtleistung HK1 Letzte 4 Wochen ohne Heute";

CM_ BO_ 2618379270 "Leistung WW ";

CM_ BO_ 2618379273 "Gesamtleistung WW Heute";

CM_ BO_ 2618379274 "Gesamtleistung WW Gestern";

CM_ BO_ 2618379275 "Gesamtleistung WW 5 Tage ohne Heute";

CM_ BO_ 2618379276 "Gesamtleistung WW Letzte 4 Wochen ohne Heute";

CM_ BO_ 2618380294 "Leistung Solar ";

CM_ BO_ 2618380297 "Gesamtleistung Solar Heute";

CM_ BO_ 2618380298 "Gesamtleistung Solar Gestern";

CM_ BO_ 2618380299 "Gesamtleistung Solar 5 Tage ohne Heute";

CM_ BO_ 2618380300 "Gesamtleistung Solar Letzte 4 Wochen ohne Heute";
