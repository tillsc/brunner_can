CM_ BO_ 470827008 "Volumenstrom Solar ";
BO_ 470827008 BHZ3_VOLUMENSTROM_SOLAR: 4 BHZ3
  SG_ BHZ3_VOLUMENSTROM_SOLAR : 7|24@0- (0.1,0) [0|0] "l/min" DBG

CM_ BO_ 470827009 "Volumenstrom WW ";
BO_ 470827009 BHZ3_VOLUMENSTROM_WW: 4 BHZ3
  SG_ BHZ3_VOLUMENSTROM_WW : 7|24@0- (0.1,0) [0|0] "l/min" DBG

CM_ BO_ 470827011 "Volumenstrom Festbrennofen ";
BO_ 470827011 BHZ3_VOLUMENSTROM_FESTBRENNOFEN: 4 BHZ3
  SG_ BHZ3_VOLUMENSTROM_FESTBRENNOFEN : 7|24@0- (0.1,0) [0|0] "l/min" DBG

CM_ BO_ 470827012 "Volumenstrom Zusatzheizung ";
BO_ 470827012 BHZ3_VOLUMENSTROM_ZUSATZHEIZUNG: 4 BHZ3
  SG_ BHZ3_VOLUMENSTROM_ZUSATZHEIZUNG : 7|24@0- (0.1,0) [0|0] "l/min" DBG

CM_ BO_ 470827013 "Druck Puffer ";
BO_ 470827013 BHZ3_DRUCK_PUFFER: 4 BHZ3
  SG_ BHZ3_DRUCK_PUFFER : 7|24@0- (0.1,0) [0|0] "bar" DBG

CM_ BO_ 470827014 "Volumenstrom HK1 ";
BO_ 470827014 BHZ3_VOLUMENSTROM_HK1: 4 BHZ3
  SG_ BHZ3_VOLUMENSTROM_HK1 : 7|24@0- (0.1,0) [0|0] "l/min" DBG

CM_ BO_ 470827017 "Temperatur HK1 VL";
BO_ 470827017 BHZ3_TEMPERATUR_HK1_VL: 4 BHZ3
  SG_ BHZ3_TEMPERATUR_HK1_VL : 7|24@0- (0.1,0) [0|0] "°C" DBG

CM_ BO_ 470827018 "Temperatur HK2 VL";
BO_ 470827018 BHZ3_TEMPERATUR_HK2_VL: 4 BHZ3
  SG_ BHZ3_TEMPERATUR_HK2_VL : 7|24@0- (0.1,0) [0|0] "°C" DBG

CM_ BO_ 470827019 "Temperatur Puffer Oben";
BO_ 470827019 BHZ3_TEMPERATUR_PUFFER_OBEN: 4 BHZ3
  SG_ BHZ3_TEMPERATUR_PUFFER_OBEN : 7|24@0- (0.1,0) [0|0] "°C" DBG

CM_ BO_ 470827020 "Temperatur Puffer Mitte";
BO_ 470827020 BHZ3_TEMPERATUR_PUFFER_MITTE: 4 BHZ3
  SG_ BHZ3_TEMPERATUR_PUFFER_MITTE : 7|24@0- (0.1,0) [0|0] "°C" DBG

CM_ BO_ 470827021 "Temperatur Puffer Unten";
BO_ 470827021 BHZ3_TEMPERATUR_PUFFER_UNTEN: 4 BHZ3
  SG_ BHZ3_TEMPERATUR_PUFFER_UNTEN : 7|24@0- (0.1,0) [0|0] "°C" DBG

CM_ BO_ 470827022 "Temperatur Solar Eintrag Puffer";
BO_ 470827022 BHZ3_TEMPERATUR_SOLAR_EINTRAG_PUFFER: 4 BHZ3
  SG_ BHZ3_TEMPERATUR_SOLAR_EINTRAG_PUFFER : 7|24@0- (0.1,0) [0|0] "°C" DBG

CM_ BO_ 470827023 "Temperatur Solar Kollektortemperatur";
BO_ 470827023 BHZ3_TEMPERATUR_SOLAR_KOLLEKTORTEMPERATUR: 4 BHZ3
  SG_ BHZ3_TEMPERATUR_SOLAR_KOLLEKTORTEMPERATUR : 7|24@0- (0.1,0) [0|0] "°C" DBG

CM_ BO_ 470827024 "Temperatur Solar RL";
BO_ 470827024 BHZ3_TEMPERATUR_SOLAR_RL: 4 BHZ3
  SG_ BHZ3_TEMPERATUR_SOLAR_RL : 7|24@0- (0.1,0) [0|0] "°C" DBG

CM_ BO_ 470827026 "Temperatur WW Zirkulation";
BO_ 470827026 BHZ3_TEMPERATUR_WW_ZIRKULATION: 4 BHZ3
  SG_ BHZ3_TEMPERATUR_WW_ZIRKULATION : 7|24@0- (0.1,0) [0|0] "°C" DBG

CM_ BO_ 470827027 "Temperatur Wetter ";
BO_ 470827027 BHZ3_TEMPERATUR_WETTER: 4 BHZ3
  SG_ BHZ3_TEMPERATUR_WETTER : 7|24@0- (0.1,0) [0|0] "°C" DBG

CM_ BO_ 470827028 "Temperatur Festbrennofen Kesseltemperatur";
BO_ 470827028 BHZ3_TEMPERATUR_FESTBRENNOFEN_KESSELTEMPERATUR: 4 BHZ3
  SG_ BHZ3_TEMPERATUR_FESTBRENNOFEN_KESSELTEMPERATUR : 7|24@0- (0.1,0) [0|0] "°C" DBG

CM_ BO_ 470827029 "Temperatur Festbrennofen Kessel RL";
BO_ 470827029 BHZ3_TEMPERATUR_FESTBRENNOFEN_KESSEL_RL: 4 BHZ3
  SG_ BHZ3_TEMPERATUR_FESTBRENNOFEN_KESSEL_RL : 7|24@0- (0.1,0) [0|0] "°C" DBG

CM_ BO_ 470827030 "Temperatur Solar Sek RL";
BO_ 470827030 BHZ3_TEMPERATUR_SOLAR_SEK_RL: 4 BHZ3
  SG_ BHZ3_TEMPERATUR_SOLAR_SEK_RL : 7|24@0- (0.1,0) [0|0] "°C" DBG

CM_ BO_ 470827033 "Temperatur Solar Prim VL";
BO_ 470827033 BHZ3_TEMPERATUR_SOLAR_PRIM_VL: 4 BHZ3
  SG_ BHZ3_TEMPERATUR_SOLAR_PRIM_VL : 7|24@0- (0.1,0) [0|0] "°C" DBG

CM_ BO_ 470827035 "Temperatur Zusatzheizung VL";
BO_ 470827035 BHZ3_TEMPERATUR_ZUSATZHEIZUNG_VL: 4 BHZ3
  SG_ BHZ3_TEMPERATUR_ZUSATZHEIZUNG_VL : 7|24@0- (0.1,0) [0|0] "°C" DBG

CM_ BO_ 470827036 "Temperatur Zusatzheizung RL";
BO_ 470827036 BHZ3_TEMPERATUR_ZUSATZHEIZUNG_RL: 4 BHZ3
  SG_ BHZ3_TEMPERATUR_ZUSATZHEIZUNG_RL : 7|24@0- (0.1,0) [0|0] "°C" DBG

CM_ BO_ 470827038 "Temperatur HK1 RL";
BO_ 470827038 BHZ3_TEMPERATUR_HK1_RL: 4 BHZ3
  SG_ BHZ3_TEMPERATUR_HK1_RL : 7|24@0- (0.1,0) [0|0] "°C" DBG

CM_ BO_ 470827039 "Temperatur HK2 RL";
BO_ 470827039 BHZ3_TEMPERATUR_HK2_RL: 4 BHZ3
  SG_ BHZ3_TEMPERATUR_HK2_RL : 7|24@0- (0.1,0) [0|0] "°C" DBG

CM_ BO_ 470827040 "Temperatur WW Prim VL";
BO_ 470827040 BHZ3_TEMPERATUR_WW_PRIM_VL: 4 BHZ3
  SG_ BHZ3_TEMPERATUR_WW_PRIM_VL : 7|24@0- (0.1,0) [0|0] "°C" DBG

CM_ BO_ 470827041 "Temperatur WW Prim RL";
BO_ 470827041 BHZ3_TEMPERATUR_WW_PRIM_RL: 4 BHZ3
  SG_ BHZ3_TEMPERATUR_WW_PRIM_RL : 7|24@0- (0.1,0) [0|0] "°C" DBG

CM_ BO_ 470827042 "Temperatur WW Ist";
BO_ 470827042 BHZ3_TEMPERATUR_WW_IST: 4 BHZ3
  SG_ BHZ3_TEMPERATUR_WW_IST : 7|24@0- (0.1,0) [0|0] "°C" DBG

CM_ BO_ 470835202 "UNKLAHR WW ";
BO_ 470835202 BHZ3_UNKLAHR_WW: 4 BHZ3
  SG_ BHZ3_UNKLAHR_WW : 7|24@0- (1,0) [0|0] "" DBG

CM_ BO_ 470835208 "Status HK1 Ein Aus";
BO_ 470835208 BHZ3_STATUS_HK1_EIN_AUS: 4 BHZ3
  SG_ BHZ3_STATUS_HK1_EIN_AUS : 7|24@0- (1,0) [0|0] "" DBG

CM_ BO_ 470835210 "Status HK1 Aus Ein";
BO_ 470835210 BHZ3_STATUS_HK1_AUS_EIN: 4 BHZ3
  SG_ BHZ3_STATUS_HK1_AUS_EIN : 7|24@0- (1,0) [0|0] "" DBG

CM_ BO_ 470835219 "Status Zusatzheizung aktiv";
BO_ 470835219 BHZ3_STATUS_ZUSATZHEIZUNG_AKTIV: 4 BHZ3
  SG_ BHZ3_STATUS_ZUSATZHEIZUNG_AKTIV : 7|24@0- (1,0) [0|0] "" DBG

CM_ BO_ 470843418 "Leistung Festbrennofen ";
BO_ 470843418 BHZ3_LEISTUNG_FESTBRENNOFEN: 4 BHZ3
  SG_ BHZ3_LEISTUNG_FESTBRENNOFEN : 7|24@0- (0.1,0) [0|0] "kw" DBG

CM_ BO_ 470843421 "Gesamtleistung Festbrennofen Heute";
BO_ 470843421 BHZ3_GESAMTLEISTUNG_FESTBRENNOFEN_HEUTE: 4 BHZ3
  SG_ BHZ3_GESAMTLEISTUNG_FESTBRENNOFEN_HEUTE : 7|24@0- (0.1,0) [0|0] "kwh" DBG

CM_ BO_ 470843422 "Gesamtleistung Festbrennofen Gestern";
BO_ 470843422 BHZ3_GESAMTLEISTUNG_FESTBRENNOFEN_GESTERN: 4 BHZ3
  SG_ BHZ3_GESAMTLEISTUNG_FESTBRENNOFEN_GESTERN : 7|24@0- (0.1,0) [0|0] "kwh" DBG

CM_ BO_ 470843423 "Gesamtleistung Festbrennofen 5 Tage ohne Heute";
BO_ 470843423 BHZ3_GESAMTLEISTUNG_FESTBRENNOFEN_5_TAGE_OHNE_HEUTE: 4 BHZ3
  SG_ BHZ3_GESAMTLEISTUNG_FESTBRENNOFEN_5_TAGE_OHNE_HEUTE : 7|24@0- (0.1,0) [0|0] "kwh" DBG

CM_ BO_ 470843424 "Gesamtleistung Festbrennofen 30 Tage ohne Heute";
BO_ 470843424 BHZ3_GESAMTLEISTUNG_FESTBRENNOFEN_30_TAGE_OHNE_HEUTE: 4 BHZ3
  SG_ BHZ3_GESAMTLEISTUNG_FESTBRENNOFEN_30_TAGE_OHNE_HEUTE : 7|24@0- (1,0) [0|0] "kwh" DBG

CM_ BO_ 470852625 "Status Zusatzheizung Aktiviert fuer";
BO_ 470852625 BHZ3_STATUS_ZUSATZHEIZUNG_AKTIVIERT_FUER: 4 BHZ3
  SG_ BHZ3_STATUS_ZUSATZHEIZUNG_AKTIVIERT_FUER : 7|24@0- (1,0) [0|0] "" DBG

CM_ BO_ 470852627 "Status Zusatzheizung Ein Aus";
BO_ 470852627 BHZ3_STATUS_ZUSATZHEIZUNG_EIN_AUS: 4 BHZ3
  SG_ BHZ3_STATUS_ZUSATZHEIZUNG_EIN_AUS : 7|24@0- (1,0) [0|0] "" DBG

CM_ BO_ 470859801 "Status WW Zirkulationsprogramm";
BO_ 470859801 BHZ3_STATUS_WW_ZIRKULATIONSPROGRAMM: 4 BHZ3
  SG_ BHZ3_STATUS_WW_ZIRKULATIONSPROGRAMM : 7|24@0- (1,0) [0|0] "" DBG

CM_ BO_ 470859831 "Temperatur WW Soll";
BO_ 470859831 BHZ3_TEMPERATUR_WW_SOLL: 4 BHZ3
  SG_ BHZ3_TEMPERATUR_WW_SOLL : 7|24@0- (0.1,0) [0|0] "°C" DBG

CM_ BO_ 470884358 "Volumenstrom WW-Speicher ";
BO_ 470884358 BHZ3_VOLUMENSTROM_WW_SPEICHER: 4 BHZ3
  SG_ BHZ3_VOLUMENSTROM_WW_SPEICHER : 7|24@0- (0.1,0) [0|0] "l/min" DBG

CM_ BO_ 470884366 "Status HK1 Absenkart";
BO_ 470884366 BHZ3_STATUS_HK1_ABSENKART: 4 BHZ3
  SG_ BHZ3_STATUS_HK1_ABSENKART : 7|24@0- (1,0) [0|0] "" DBG

CM_ BO_ 470884371 "Status HK1 Sommerbetrieb";
BO_ 470884371 BHZ3_STATUS_HK1_SOMMERBETRIEB: 4 BHZ3
  SG_ BHZ3_STATUS_HK1_SOMMERBETRIEB : 7|24@0- (0.1,0) [0|0] "°C" DBG

CM_ BO_ 470884382 "Status HK1 Dauerbetrieb";
BO_ 470884382 BHZ3_STATUS_HK1_DAUERBETRIEB: 4 BHZ3
  SG_ BHZ3_STATUS_HK1_DAUERBETRIEB : 7|24@0- (1,0) [0|0] "h" DBG

CM_ BO_ 470884383 "Status HK1 Abwesenheitszeit";
BO_ 470884383 BHZ3_STATUS_HK1_ABWESENHEITSZEIT: 4 BHZ3
  SG_ BHZ3_STATUS_HK1_ABWESENHEITSZEIT : 7|24@0- (1,0) [0|0] "d" DBG

CM_ BO_ 470884386 "Status HK1 Programm";
BO_ 470884386 BHZ3_STATUS_HK1_PROGRAMM: 4 BHZ3
  SG_ BHZ3_STATUS_HK1_PROGRAMM : 7|24@0- (1,0) [0|0] "" DBG

CM_ BO_ 470884388 "Status HK1 Waermer Kaelter";
BO_ 470884388 BHZ3_STATUS_HK1_WAERMER_KAELTER: 4 BHZ3
  SG_ BHZ3_STATUS_HK1_WAERMER_KAELTER : 7|24@0- (0.1,0) [0|0] "°C" DBG

CM_ BO_ 470892550 "Leistung Zusatzheizung ";
BO_ 470892550 BHZ3_LEISTUNG_ZUSATZHEIZUNG: 4 BHZ3
  SG_ BHZ3_LEISTUNG_ZUSATZHEIZUNG : 7|24@0- (0.1,0) [0|0] "kw" DBG

CM_ BO_ 470892553 "Gesamtleistung Zusatzheizung Heute";
BO_ 470892553 BHZ3_GESAMTLEISTUNG_ZUSATZHEIZUNG_HEUTE: 4 BHZ3
  SG_ BHZ3_GESAMTLEISTUNG_ZUSATZHEIZUNG_HEUTE : 7|24@0- (0.1,0) [0|0] "kwh" DBG

CM_ BO_ 470892554 "Gesamtleistung Zusatzheizung Gestern";
BO_ 470892554 BHZ3_GESAMTLEISTUNG_ZUSATZHEIZUNG_GESTERN: 4 BHZ3
  SG_ BHZ3_GESAMTLEISTUNG_ZUSATZHEIZUNG_GESTERN : 7|24@0- (0.1,0) [0|0] "kwh" DBG

CM_ BO_ 470892555 "Gesamtleistung Zusatzheizung 5 Tage ohne Heute";
BO_ 470892555 BHZ3_GESAMTLEISTUNG_ZUSATZHEIZUNG_5_TAGE_OHNE_HEUTE: 4 BHZ3
  SG_ BHZ3_GESAMTLEISTUNG_ZUSATZHEIZUNG_5_TAGE_OHNE_HEUTE : 7|24@0- (0.1,0) [0|0] "kwh" DBG

CM_ BO_ 470892556 "Gesamtleistung Zusatzheizung Letzte 4 Wochen ohne Heute";
BO_ 470892556 BHZ3_GESAMTLEISTUNG_ZUSATZHEIZUNG_LETZTE_4_WOCHEN_OHNE_HEUTE: 4 BHZ3
  SG_ BHZ3_GESAMTLEISTUNG_ZUSATZHEIZUNG_LETZTE_4_WOCHEN_OHNE_HEUTE : 7|24@0- (1,0) [0|0] "kwh" DBG

CM_ BO_ 470893574 "Leistung HK1 ";
BO_ 470893574 BHZ3_LEISTUNG_HK1: 4 BHZ3
  SG_ BHZ3_LEISTUNG_HK1 : 7|24@0- (0.1,0) [0|0] "kw" DBG

CM_ BO_ 470893577 "Gesamtleistung HK1 Heute";
BO_ 470893577 BHZ3_GESAMTLEISTUNG_HK1_HEUTE: 4 BHZ3
  SG_ BHZ3_GESAMTLEISTUNG_HK1_HEUTE : 7|24@0- (0.1,0) [0|0] "kwh" DBG

CM_ BO_ 470893578 "Gesamtleistung HK1 Gestern";
BO_ 470893578 BHZ3_GESAMTLEISTUNG_HK1_GESTERN: 4 BHZ3
  SG_ BHZ3_GESAMTLEISTUNG_HK1_GESTERN : 7|24@0- (0.1,0) [0|0] "kwh" DBG

CM_ BO_ 470893579 "Gesamtleistung HK1 5 Tage ohne Heute";
BO_ 470893579 BHZ3_GESAMTLEISTUNG_HK1_5_TAGE_OHNE_HEUTE: 4 BHZ3
  SG_ BHZ3_GESAMTLEISTUNG_HK1_5_TAGE_OHNE_HEUTE : 7|24@0- (0.1,0) [0|0] "kwh" DBG

CM_ BO_ 470893580 "Gesamtleistung HK1 Letzte 4 Wochen ohne Heute";
BO_ 470893580 BHZ3_GESAMTLEISTUNG_HK1_LETZTE_4_WOCHEN_OHNE_HEUTE: 4 BHZ3
  SG_ BHZ3_GESAMTLEISTUNG_HK1_LETZTE_4_WOCHEN_OHNE_HEUTE : 7|24@0- (1,0) [0|0] "kwh" DBG

CM_ BO_ 470895622 "Leistung WW ";
BO_ 470895622 BHZ3_LEISTUNG_WW: 4 BHZ3
  SG_ BHZ3_LEISTUNG_WW : 7|24@0- (0.1,0) [0|0] "kw" DBG

CM_ BO_ 470895625 "Gesamtleistung WW Heute";
BO_ 470895625 BHZ3_GESAMTLEISTUNG_WW_HEUTE: 4 BHZ3
  SG_ BHZ3_GESAMTLEISTUNG_WW_HEUTE : 7|24@0- (0.1,0) [0|0] "kwh" DBG

CM_ BO_ 470895626 "Gesamtleistung WW Gestern";
BO_ 470895626 BHZ3_GESAMTLEISTUNG_WW_GESTERN: 4 BHZ3
  SG_ BHZ3_GESAMTLEISTUNG_WW_GESTERN : 7|24@0- (0.1,0) [0|0] "kwh" DBG

CM_ BO_ 470895627 "Gesamtleistung WW 5 Tage ohne Heute";
BO_ 470895627 BHZ3_GESAMTLEISTUNG_WW_5_TAGE_OHNE_HEUTE: 4 BHZ3
  SG_ BHZ3_GESAMTLEISTUNG_WW_5_TAGE_OHNE_HEUTE : 7|24@0- (0.1,0) [0|0] "kwh" DBG

CM_ BO_ 470895628 "Gesamtleistung WW Letzte 4 Wochen ohne Heute";
BO_ 470895628 BHZ3_GESAMTLEISTUNG_WW_LETZTE_4_WOCHEN_OHNE_HEUTE: 4 BHZ3
  SG_ BHZ3_GESAMTLEISTUNG_WW_LETZTE_4_WOCHEN_OHNE_HEUTE : 7|24@0- (1,0) [0|0] "kwh" DBG

CM_ BO_ 470896646 "Leistung Solar ";
BO_ 470896646 BHZ3_LEISTUNG_SOLAR: 4 BHZ3
  SG_ BHZ3_LEISTUNG_SOLAR : 7|24@0- (0.1,0) [0|0] "kw" DBG

CM_ BO_ 470896649 "Gesamtleistung Solar Heute";
BO_ 470896649 BHZ3_GESAMTLEISTUNG_SOLAR_HEUTE: 4 BHZ3
  SG_ BHZ3_GESAMTLEISTUNG_SOLAR_HEUTE : 7|24@0- (0.1,0) [0|0] "kwh" DBG

CM_ BO_ 470896650 "Gesamtleistung Solar Gestern";
BO_ 470896650 BHZ3_GESAMTLEISTUNG_SOLAR_GESTERN: 4 BHZ3
  SG_ BHZ3_GESAMTLEISTUNG_SOLAR_GESTERN : 7|24@0- (0.1,0) [0|0] "kwh" DBG

CM_ BO_ 470896651 "Gesamtleistung Solar 5 Tage ohne Heute";
BO_ 470896651 BHZ3_GESAMTLEISTUNG_SOLAR_5_TAGE_OHNE_HEUTE: 4 BHZ3
  SG_ BHZ3_GESAMTLEISTUNG_SOLAR_5_TAGE_OHNE_HEUTE : 7|24@0- (0.1,0) [0|0] "kwh" DBG

CM_ BO_ 470896652 "Gesamtleistung Solar Letzte 4 Wochen ohne Heute";
BO_ 470896652 BHZ3_GESAMTLEISTUNG_SOLAR_LETZTE_4_WOCHEN_OHNE_HEUTE: 4 BHZ3
  SG_ BHZ3_GESAMTLEISTUNG_SOLAR_LETZTE_4_WOCHEN_OHNE_HEUTE : 7|24@0- (1,0) [0|0] "kwh" DBG
