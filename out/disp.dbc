CM_ BO_ 168863250 "Steuerung Zusatzheizung Programm";
BO_ 168863250 DISP_STEUERUNG_ZUSATZHEIZUNG_PROGRAMM: 4 DISP
  SG_ DISP_STEUERUNG_ZUSATZHEIZUNG_PROGRAMM : 7|24@0- (1,0) [0|0] "" DBG

CM_ BO_ 168870429 "Steuerung WW Solltemperatur PWT";
BO_ 168870429 DISP_STEUERUNG_WW_SOLLTEMPERATUR_PWT: 4 DISP
  SG_ DISP_STEUERUNG_WW_SOLLTEMPERATUR_PWT : 7|24@0- (0.1,0) [0|0] "°C" DBG

CM_ BO_ 168895006 "Steuerung HK1 Dauerbetrieb";
BO_ 168895006 DISP_STEUERUNG_HK1_DAUERBETRIEB: 4 DISP
  SG_ DISP_STEUERUNG_HK1_DAUERBETRIEB : 7|24@0- (1,0) [0|0] "Stunden" DBG

CM_ BO_ 168895012 "Steuerung HK1 Waermer Kaelter";
BO_ 168895012 DISP_STEUERUNG_HK1_WAERMER_KAELTER: 4 DISP
  SG_ DISP_STEUERUNG_HK1_WAERMER_KAELTER : 7|24@0- (0.1,0) [0|0] "°C" DBG

CM_ BO_ 303088153 "Steuerung WW Zirkulationsprogramm";
BO_ 303088153 DISP_STEUERUNG_WW_ZIRKULATIONSPROGRAMM: 4 DISP
  SG_ DISP_STEUERUNG_WW_ZIRKULATIONSPROGRAMM : 7|24@0- (1,0) [0|0] "" DBG

CM_ BO_ 303112723 "Steuerung HK1 Sommerbetrieb";
BO_ 303112723 DISP_STEUERUNG_HK1_SOMMERBETRIEB: 4 DISP
  SG_ DISP_STEUERUNG_HK1_SOMMERBETRIEB : 7|24@0- (0.1,0) [0|0] "°C" DBG

CM_ BO_ 303112735 "Steuerung HK1 Abwesenheitszeit";
BO_ 303112735 DISP_STEUERUNG_HK1_ABWESENHEITSZEIT: 4 DISP
  SG_ DISP_STEUERUNG_HK1_ABWESENHEITSZEIT : 7|24@0- (1,0) [0|0] "Tage" DBG

CM_ BO_ 303112738 "Steuerung HK1 Programm";
BO_ 303112738 DISP_STEUERUNG_HK1_PROGRAMM: 4 DISP
  SG_ DISP_STEUERUNG_HK1_PROGRAMM : 7|24@0- (1,0) [0|0] "" DBG

CM_ BO_ 314098189 "Steuerung Festbrennofen Holzart";
BO_ 314098189 DISP_STEUERUNG_FESTBRENNOFEN_HOLZART: 4 DISP
  SG_ DISP_STEUERUNG_FESTBRENNOFEN_HOLZART : 7|24@0- (1,0) [0|0] "" DBG
