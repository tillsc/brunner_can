VERSION ""

NS_ :

BS_:

BU_: DISP

BO_ 2316346898 DISP_STEUERUNG_ZUSATZHEIZUNG_PROGRAMM: 4 DISP
  SG_ DISP_STEUERUNG_ZUSATZHEIZUNG_PROGRAMM : 15|16@0- (1,0) [0|0] "" DBG

BO_ 2316354077 DISP_STEUERUNG_WW_SOLLTEMPERATUR_PWT: 4 DISP
  SG_ DISP_STEUERUNG_WW_SOLLTEMPERATUR_PWT : 15|16@0- (0.1,0) [0|0] "°C" DBG

BO_ 2316378654 DISP_STEUERUNG_HK1_DAUERBETRIEB: 4 DISP
  SG_ DISP_STEUERUNG_HK1_DAUERBETRIEB : 15|16@0- (1,0) [0|0] "Stunden" DBG

BO_ 2316378660 DISP_STEUERUNG_HK1_WAERMER_KAELTER: 4 DISP
  SG_ DISP_STEUERUNG_HK1_WAERMER_KAELTER : 15|16@0- (0.1,0) [0|0] "°C" DBG

BO_ 2450571801 DISP_STEUERUNG_WW_ZIRKULATIONSPROGRAMM: 4 DISP
  SG_ DISP_STEUERUNG_WW_ZIRKULATIONSPROGRAMM : 15|16@0- (1,0) [0|0] "" DBG

BO_ 2450596371 DISP_STEUERUNG_HK1_SOMMERBETRIEB: 4 DISP
  SG_ DISP_STEUERUNG_HK1_SOMMERBETRIEB : 15|16@0- (0.1,0) [0|0] "°C" DBG

BO_ 2450596383 DISP_STEUERUNG_HK1_ABWESENHEITSZEIT: 4 DISP
  SG_ DISP_STEUERUNG_HK1_ABWESENHEITSZEIT : 15|16@0- (1,0) [0|0] "Tage" DBG

BO_ 2450596386 DISP_STEUERUNG_HK1_PROGRAMM: 4 DISP
  SG_ DISP_STEUERUNG_HK1_PROGRAMM : 15|16@0- (1,0) [0|0] "" DBG

BO_ 2461581837 DISP_STEUERUNG_FESTBRENNOFEN_HOLZART: 4 DISP
  SG_ DISP_STEUERUNG_FESTBRENNOFEN_HOLZART : 15|16@0- (1,0) [0|0] "" DBG

CM_ BO_ 2316346898 "Steuerung Zusatzheizung Programm";
CM_ SG_ 2316346898 DISP_STEUERUNG_ZUSATZHEIZUNG_PROGRAMM "0 - 5";

CM_ BO_ 2316354077 "Steuerung WW Solltemperatur PWT";

CM_ BO_ 2316378654 "Steuerung HK1 Dauerbetrieb";

CM_ BO_ 2316378660 "Steuerung HK1 Waermer Kaelter";

CM_ BO_ 2450571801 "Steuerung WW Zirkulationsprogramm";
CM_ SG_ 2450571801 DISP_STEUERUNG_WW_ZIRKULATIONSPROGRAMM "0 - 5";

CM_ BO_ 2450596371 "Steuerung HK1 Sommerbetrieb";

CM_ BO_ 2450596383 "Steuerung HK1 Abwesenheitszeit";

CM_ BO_ 2450596386 "Steuerung HK1 Programm";
CM_ SG_ 2450596386 DISP_STEUERUNG_HK1_PROGRAMM "0 - 5";

CM_ BO_ 2461581837 "Steuerung Festbrennofen Holzart";
CM_ SG_ 2461581837 DISP_STEUERUNG_FESTBRENNOFEN_HOLZART "0 - 2";
