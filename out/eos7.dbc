CM_ BO_ 470852626 "Steuerung Zusatzheizung Programm";
BO_ 470852626 EOS7_STEUERUNG_ZUSATZHEIZUNG_PROGRAMM: 4 EOS7
  SG_ EOS7_STEUERUNG_ZUSATZHEIZUNG_PROGRAMM : 7|24@0- (1,0) [0|0] "" DBG

CM_ BO_ 481845248 "Temperatur Festbrennofen Brennraumtemperatur";
BO_ 481845248 EOS7_TEMPERATUR_FESTBRENNOFEN_BRENNRAUMTEMPERATUR: 4 EOS7
  SG_ EOS7_TEMPERATUR_FESTBRENNOFEN_BRENNRAUMTEMPERATUR : 7|24@0- (0.1,0) [0|0] "°C" DBG

CM_ BO_ 481845249 "Temperatur Festbrennofen Kesseltemperatur";
BO_ 481845249 EOS7_TEMPERATUR_FESTBRENNOFEN_KESSELTEMPERATUR: 4 EOS7
  SG_ EOS7_TEMPERATUR_FESTBRENNOFEN_KESSELTEMPERATUR : 7|24@0- (0.1,0) [0|0] "°C" DBG

CM_ BO_ 481845256 "Status Festbrennofen Tuer zu";
BO_ 481845256 EOS7_STATUS_FESTBRENNOFEN_TUER_ZU: 4 EOS7
  SG_ EOS7_STATUS_FESTBRENNOFEN_TUER_ZU : 7|24@0- (1,0) [0|0] "" DBG

CM_ BO_ 481869837 "Status Festbrennofen Holzart";
BO_ 481869837 EOS7_STATUS_FESTBRENNOFEN_HOLZART: 4 EOS7
  SG_ EOS7_STATUS_FESTBRENNOFEN_HOLZART : 7|24@0- (1,0) [0|0] "" DBG

CM_ BO_ 481869838 "Status Festbrennofen Oekobetrieb aus";
BO_ 481869838 EOS7_STATUS_FESTBRENNOFEN_OEKOBETRIEB_AUS: 4 EOS7
  SG_ EOS7_STATUS_FESTBRENNOFEN_OEKOBETRIEB_AUS : 7|24@0- (1,0) [0|0] "" DBG
