VERSION ""

NS_ :

BS_:

BU_: EOS7

BO_ 2618336274 EOS7_STEUERUNG_ZUSATZHEIZUNG_PROGRAMM: 4 EOS7
  SG_ EOS7_STEUERUNG_ZUSATZHEIZUNG_PROGRAMM : 15|16@0- (1,0) [0|0] "" DBG

CM_ BO_ 2618336274 "Steuerung Zusatzheizung Programm";
CM_ SG_ 2618336274 EOS7_STEUERUNG_ZUSATZHEIZUNG_PROGRAMM "0 - 5";

BO_ 2629328896 EOS7_TEMPERATUR_FESTBRENNOFEN_BRENNRAUMTEMPERATUR: 4 EOS7
  SG_ EOS7_TEMPERATUR_FESTBRENNOFEN_BRENNRAUMTEMPERATUR : 15|16@0- (0.1,0) [0|0] "°C" DBG

CM_ BO_ 2629328896 "Temperatur Festbrennofen Brennraumtemperatur";

BO_ 2629328897 EOS7_TEMPERATUR_FESTBRENNOFEN_KESSELTEMPERATUR: 4 EOS7
  SG_ EOS7_TEMPERATUR_FESTBRENNOFEN_KESSELTEMPERATUR : 15|16@0- (0.1,0) [0|0] "°C" DBG

CM_ BO_ 2629328897 "Temperatur Festbrennofen Kesseltemperatur";

BO_ 2629328904 EOS7_STATUS_FESTBRENNOFEN_TUER_ZU: 4 EOS7
  SG_ EOS7_STATUS_FESTBRENNOFEN_TUER_ZU : 15|16@0- (1,0) [0|0] "" DBG

CM_ BO_ 2629328904 "Status Festbrennofen Tuer zu";
CM_ SG_ 2629328904 EOS7_STATUS_FESTBRENNOFEN_TUER_ZU "0, 1";

BO_ 2629353485 EOS7_STATUS_FESTBRENNOFEN_HOLZART: 4 EOS7
  SG_ EOS7_STATUS_FESTBRENNOFEN_HOLZART : 15|16@0- (1,0) [0|0] "" DBG

CM_ BO_ 2629353485 "Status Festbrennofen Holzart";
CM_ SG_ 2629353485 EOS7_STATUS_FESTBRENNOFEN_HOLZART "0 - 2";

BO_ 2629353486 EOS7_STATUS_FESTBRENNOFEN_OEKOBETRIEB_AUS: 4 EOS7
  SG_ EOS7_STATUS_FESTBRENNOFEN_OEKOBETRIEB_AUS : 15|16@0- (1,0) [0|0] "" DBG

CM_ BO_ 2629353486 "Status Festbrennofen Oekobetrieb aus";
CM_ SG_ 2629353486 EOS7_STATUS_FESTBRENNOFEN_OEKOBETRIEB_AUS "0, 1";
